#if defined(SAA_SPLIT_ROLE_CENTRAL)
&left_encoder {
    a-gpios = ENCODER_A_GPIOS;
    b-gpios = ENCODER_B_GPIOS;
    steps = <24>;
    status = "okay";
};
#endif

#if defined(SAA_SPLIT_ROLE_PERIPHERAL)
&right_encoder {
    a-gpios = ENCODER_A_GPIOS;
    b-gpios = ENCODER_B_GPIOS;
    steps = <24>;
    status = "okay";
};
#endif

&sensors {
   triggers-per-rotation = <10>;
};
