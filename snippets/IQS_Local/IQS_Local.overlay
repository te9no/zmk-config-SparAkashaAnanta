/ {
    iqs_listener: iqs_listener {
        compatible = "zmk,input-listener";
        status = "okay";
        device = <&iqs9151>;
        input-processors = <&zip_xy_transform (INPUT_TRANSFORM_X_INVERT)>,
                           <&zip_xy_scaler 1 6>,
                           <&zip_scroll_scaler 1 40>,
                           <&zip_dynamic_xy_scaler>,
                           <&zip_dynamic_scroll_scaler>;

        lowspeedmode {
            layers = <1>, <2>;
            input-processors = <&zip_xy_transform (INPUT_TRANSFORM_X_INVERT)>,
                               <&zip_xy_scaler 1 12>,
                               <&zip_scroll_scaler 1 70>,
                               <&zip_dynamic_xy_scaler>,
                               <&zip_dynamic_scroll_scaler>;
        };
    };
};

