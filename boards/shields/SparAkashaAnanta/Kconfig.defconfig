## boards/shields/SparAkashaAnanta/Kconfig.defconfig
```kconfig
if SHIELD_SAA_L_Base || SHIELD_SAA_R_Base

config ZMK_KEYBOARD_NAME
	default "Ananta"

config ZMK_SPLIT
	default y

if ZMK_DISPLAY

config I2C
	default y

config SSD1306
	default y

endif # ZMK_DISPLAY

if LVGL

config LV_Z_VDB_SIZE
	default 64

config LV_DPI_DEF
	default 148

config LV_Z_BITS_PER_PIXEL
	default 1

choice LV_COLOR_DEPTH
	default LV_COLOR_DEPTH_1
endchoice

endif # LVGL

endif # SHIELD_SAA_L_Base || SHIELD_SAA_R_Base

config ZMK_ZEROSHIFT_STUDIO
    default y if SHIELD_SAA_R_ZS && ZMK_STUDIO_RPC && !ZMK_SETTINGS_RESET_ON_START

config ZMK_BT_RECOVERY
    default y if ZMK_ZEROSHIFT && ZMK_SPLIT_BLE && !ZMK_SETTINGS_RESET_ON_START
```

## boards/shields/SparAkashaAnanta/Kconfig.shield
```kconfig
config SHIELD_SAA_R_Base
    def_bool $(shields_list_contains,SAA_R_Base)

config SHIELD_SAA_L_Base
    def_bool $(shields_list_contains,SAA_L_Base)

config SHIELD_SAA_L_ZS
    def_bool $(shields_list_contains,SAA_L_ZS)

config SHIELD_SAA_R_ZS
    def_bool $(shields_list_contains,SAA_R_ZS)
```

## dts/bindings/sensor/saa,deferred-ec11.yaml
```yaml
# SPDX-License-Identifier: MIT

description: EC11 encoder on a Ananta slot initialized from the saved module selection
compatible: "saa,deferred-ec11"

include:
  - name: alps,ec11.yaml
  - name: base.yaml
    property-allowlist:
      - zephyr,deferred-init
```
