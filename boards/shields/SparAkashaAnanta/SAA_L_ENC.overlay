&left_encoder {
    a-gpios = <&gpio1 12 (GPIO_ACTIVE_HIGH | GPIO_PULL_UP)>;
    b-gpios = <&gpio1 13 (GPIO_ACTIVE_HIGH | GPIO_PULL_UP)>;
    steps = <24>;
    status = "okay"; 
};

&sensors {
   triggers-per-rotation = <10>;
};