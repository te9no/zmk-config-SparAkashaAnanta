## boards/shields/SparAkashaAnanta/Kconfig.shield
```kconfig
config SHIELD_SAA_R_Base
    def_bool $(shields_list_contains,SAA_R_Base)

config SHIELD_SAA_L_Base
    def_bool $(shields_list_contains,SAA_L_Base)
```

## dts/bindings/behaviors/saa,behavior-module-select.yaml
```yaml
description: SparAkashaAnanta module profile selection behavior

compatible: "saa,behavior-module-select"

include: one_param.yaml
```

## dts/bindings/behaviors/zmk,behavior-debug-toggle.yaml
```yaml
# Copyright (c) 2026
# SPDX-License-Identifier: MIT

description: Debug Log Toggle Behavior

compatible: "zmk,behavior-debug-toggle"

include: zero_param.yaml
```

## dts/bindings/behaviors/zmk,behavior-input-module-select.yaml
```yaml
description: Runtime input module profile selection behavior

compatible: "zmk,behavior-input-module-select"

include: one_param.yaml
```

## dts/bindings/saa,module-detector.yaml
```yaml
description: SparAkashaAnanta module ID strap detector

compatible: "saa,module-detector"

properties:
  id-gpios:
    type: phandle-array
    required: true
    description: GPIO pins used as little-endian module ID bits.

  module-names:
    type: string-array
    required: true
    description: Names indexed by the detected module ID value.

  expected-module:
    type: string
    description: Module class expected by the selected firmware snippet.
```

## dts/bindings/saa,module-mux.yaml
```yaml
description: SparAkashaAnanta selected module input path mux

compatible: "saa,module-mux"

properties:
  key-kscan:
    type: phandle
    description: Deferred kscan device used for the direct key module.

  left-encoder:
    type: phandle
    description: Deferred left-side encoder device.

  right-encoder:
    type: phandle
    description: Deferred right-side encoder device.

  joystick-input:
    type: phandle
    description: Deferred analog input device used for the joystick module.

  trackball-input:
    type: phandle
    description: Deferred PMW3610 input device used for the trackball module.

  touchpad-input:
    type: phandle
    description: Deferred touchpad input device used for the TPD module.
```

## dts/bindings/zmk,input-module-kscan-proxy.yaml
```yaml
description: Runtime-selected input module kscan proxy

compatible: "zmk,input-module-kscan-proxy"

child-binding:
  description: Kscan route for an input module profile

  properties:
    profile-id:
      type: int
      required: true
      description: Numeric input module profile ID.

    kscan:
      type: phandle
      required: true
      description: Deferred kscan device used when this profile is selected.
```

## dts/bindings/zmk,input-module-mux.yaml
```yaml
description: Runtime-selected input module profile mux

compatible: "zmk,input-module-mux"

properties:
  default-profile:
    type: int
    default: 0
    description: Profile ID used when no persisted setting exists.

  settings-key:
    type: string
    default: "input_module"
    description: Settings subtree used to persist the selected profile.

child-binding:
  description: Candidate input module profile

  properties:
    profile-id:
      type: int
      required: true
      description: Numeric profile ID used by keymap behaviors and settings.

    display-name:
      type: string
      required: true
      description: Human-readable profile name for logs and UI.

    capabilities:
      type: int
      default: 0
      description: Bitmask of ZMK_INPUT_MODULE_CAP_* values.

    devices:
      type: phandles
      description: Deferred devices initialized when this profile is applied.
```

## dts/bindings/zmk,input-module-sensor-proxy.yaml
```yaml
description: Runtime-selected input module sensor proxy

compatible: "zmk,input-module-sensor-proxy"

child-binding:
  description: Sensor route for an input module profile

  properties:
    profile-id:
      type: int
      required: true
      description: Numeric input module profile ID.

    sensor:
      type: phandle
      required: true
      description: Deferred sensor device used when this profile is selected.

    triggers-per-rotation:
      type: int
      default: 0
      description: >
        If non-zero, normalize SENSOR_CHAN_ROTATION degrees into legacy
        tick-style sensor values using this trigger count per rotation.
```
